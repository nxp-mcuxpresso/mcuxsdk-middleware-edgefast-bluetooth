## Kconfig.lib
```kconfig
# edgefast_bluetooth LIB configuration options
config MCUX_COMPONENT_middleware.edgefast_bluetooth.btble.ethermind.lib
	bool

config MCUX_COMPONENT_middleware.edgefast_bluetooth.br.ethermind.lib
	bool

config MCUX_COMPONENT_middleware.edgefast_bluetooth.ble.ethermind.lib
	bool

config MCUX_COMPONENT_middleware.edgefast_bluetooth.btble.ethermind.lib.lc3
	bool

config MCUX_COMPONENT_middleware.edgefast_bluetooth.br.ethermind.lib.lc3
	bool

config MCUX_COMPONENT_middleware.edgefast_bluetooth.ble.ethermind.lib.lc3
	bool

config MCUX_COMPONENT_middleware.edgefast_bluetooth.btble.ethermind.lib.lc3_nodsp
	bool

config MCUX_COMPONENT_middleware.edgefast_bluetooth.ble.ethermind.lib.lc3_nodsp
	bool
```

## Kconfig.services
```kconfig
##############################
# Profile related components #
##############################
menu "Bluetoth profile"

config MCUX_COMPONENT_middleware.edgefast_bluetooth.profile.hrs
    bool "hrs"

config MCUX_COMPONENT_middleware.edgefast_bluetooth.profile.bas
    bool "bas"

config MCUX_COMPONENT_middleware.edgefast_bluetooth.profile.dis
    bool "dis"

config MCUX_COMPONENT_middleware.edgefast_bluetooth.profile.hts
    bool "hts"

config MCUX_COMPONENT_middleware.edgefast_bluetooth.profile.ias
    bool "ias"

config MCUX_COMPONENT_middleware.edgefast_bluetooth.profile.hps
    bool "hps"

config MCUX_COMPONENT_middleware.edgefast_bluetooth.profile.pxr
    bool "pxr"

config MCUX_COMPONENT_middleware.edgefast_bluetooth.profile.ipsp
    bool "ipsp"

config MCUX_COMPONENT_middleware.edgefast_bluetooth.profile.ots
    bool "ots"

config MCUX_COMPONENT_middleware.edgefast_bluetooth.profile.wu
    bool "wu"

config MCUX_COMPONENT_middleware.edgefast_bluetooth.profile.fmp
    bool "fmp"

config MCUX_COMPONENT_middleware.edgefast_bluetooth.profile.tip
    bool "tip"

endmenu
```

## Kconfig.shell
```kconfig
###############
# shell files #
###############
config MCUX_COMPONENT_middleware.edgefast_bluetooth.shell
    bool "Bluetooth shell based on BT/BLE"
    select MCUX_COMPONENT_component.common_task
    depends on MCUX_COMPONENT_middleware.edgefast_bluetooth.btble.ethermind
    help
      Activate Bluetooth shell based on BT/BLE.

config MCUX_COMPONENT_middleware.edgefast_bluetooth.shell.le_audio
    bool "Bluetooth shell with le audio"
    select MCUX_COMPONENT_component.common_task
    depends on MCUX_COMPONENT_middleware.edgefast_bluetooth.btble.ethermind
    help
      Activate Bluetooth shell with LE audio function.

config MCUX_COMPONENT_middleware.edgefast_bluetooth.shell_ble
    bool "Bluetooth shell based on BLE"
    select MCUX_COMPONENT_component.common_task
    depends on MCUX_COMPONENT_middleware.edgefast_bluetooth.ble.ethermind
    help
      Activate Bluetooth shell based on BLE.
```

## include/Kconfig.extension
```kconfig
menu "Edgefast Bluetooth Other Configurations(edgefast_bluetooth_extension_config_Gen.h)"

config BT_HOST_CRYPTO
    bool "BT_HOST_CRYPTO"
    default n
    help
      This symbol is a config macro.

config CONTROLLER_ID
    string "CONTROLLER_ID"
    default "kUSB_ControllerEhci0"
    help
      USB Controller ID
      This symbol is a config macro.
      No prefix in generated macro

config WORK_QUEUE_TASK_PRIORITY
    string "WORK_QUEUE_TASK_PRIORITY"
    default "(configMAX_PRIORITIES - 2)"
    help
      This symbol is a config macro.

config WORK_QUEUE_TASK_STACK_SIZE
    int "WORK_QUEUE_TASK_STACK_SIZE"
    default 4096 if BT_SMP
    default 2048
    help
      This symbol is a config macro.

config BUTTON_COUNT
    int "BUTTON_COUNT"
    default 0
    help
      This symbol is a config macro.
      No prefix in generated macro

config BT_HOST_USB_ENABLE
    bool "BT_HOST_USB_ENABLE"
    help
      This symbol is a config macro.

config BT_HOST_USB_IRQ_ENABLE
    bool "BT_HOST_USB_IRQ_ENABLE"
    help
      This symbol is a config macro.

config BT_IND_RESET
    bool "BT_IND_RESET"
    help
      This symbol is a config macro.

config BT_IND_RESET_OOB
    bool "BT_IND_RESET_OOB"
    help
      This symbol is a config macro.

config BT_RF_TEST_MODE
    bool "BT_RF_TEST_MODE"
    help
      This symbol is a config macro.

config BT_WHITELIST
    bool "BT_WHITELIST"
    help
      This symbol is a config macro.

config BT_GATT_SERVER
    bool "BT_GATT_SERVER"
    help
      This symbol is a config macro.

config BLE_ADV_REPORT_BUFFER_FILTER
    bool "BLE_ADV_REPORT_BUFFER_FILTER"
    help
      This symbol is a config macro.

config BT_BLE_PLATFORM_INIT_ESCAPE
    bool "BT_BLE_PLATFORM_INIT_ESCAPE"
    help
      This symbol is a config macro.
      No prefix in generated macro

endmenu
```

## include/bluetooth/audio/config/Kconfig.cap
```kconfig
# Bluetooth Audio - Common Audio Profile (CAP) options
#
# Copyright (c) 2022 Nordic Semiconductor ASA
# Copyright 2024 NXP
#
# SPDX-License-Identifier: Apache-2.0
#

menu "cap"

config BT_CAP
	def_bool BT_CAP_ACCEPTOR || BT_CAP_INITIATOR
	help
	  This symbol is a config macro.

config BT_CAP_ACCEPTOR
	bool "Common Audio Profile Acceptor Role Support"
	depends on BT_BAP_UNICAST_SERVER || (BT_BAP_BROADCAST_SINK && BT_BAP_SCAN_DELEGATOR)
	depends on BT_AUDIO_CODEC_CFG_MAX_METADATA_SIZE >= 4
	help
	  Enabling this will enable the CAP Acceptor role. This instantiates the
	  common audio service (CAS).
	  This symbol is a config macro.

config BT_CAP_ACCEPTOR_SET_MEMBER
	bool "Common Audio Profile Acceptor Role Set Member support"
	depends on BT_CAP_ACCEPTOR
	depends on BT_CSIP_SET_MEMBER
	select BT_GATT_DYNAMIC_DB
	help
	  Enabling this will allow a CAP acceptor to be a set member.
	  Enabling this will require a manual register of the CAS service.
	  Enabling will take one of the allocated CSIS instances
	  (BT_CSIP_SET_MEMBER_MAX_INSTANCE_COUNT).
	  This symbol is a config macro.

config BT_CAP_INITIATOR_UNICAST
	def_bool BT_CAP_INITIATOR && BT_BAP_UNICAST_CLIENT
	help
	  This symbol is a config macro.

config BT_CAP_INITIATOR
	bool "Common Audio Profile Initiator Role Support"
	depends on (BT_BAP_UNICAST_CLIENT && BT_CSIP_SET_COORDINATOR) || BT_BAP_BROADCAST_SOURCE
	depends on BT_AUDIO_CODEC_CFG_MAX_METADATA_SIZE >= 4
	help
	  Enabling this will enable the CAP Initiator role.
	  This symbol is a config macro.

config BT_CAP_COMMANDER
	bool "Common Audio Profile Initiator Role Support"
	depends on (BT_BAP_BROADCAST_ASSISTANT && BT_BAP_SCAN_DELEGATOR && BT_CSIP_SET_COORDINATOR) || \
		   (BT_BAP_SCAN_DELEGATOR && BT_CSIP_SET_COORDINATOR) || \
		   (BT_VCP_VOL_CTLR && BT_CSIP_SET_COORDINATOR) || \
		   (BT_MICP_MIC_CTLR && BT_CSIP_SET_COORDINATOR) || \
		   BT_TBS_CLIENT || \
		   BT_MCC
	help
	  Enabling this will enable the CAP Initiator role.
	  This symbol is a config macro.

endmenu
```

## include/bluetooth/audio/config/Kconfig.extension
```kconfig
# Copyright 2024 NXP

menu "extension"

config LE_AUDIO_SYNC_ENABLE
	bool "LE_AUDIO_SYNC_ENABLE"
	help
	  LE Audio Sync Enable.
	  This symbol is a config macro.
	  No prefix in generated macro

config BT_AUDIO_CAPABILITY
	bool "BT_AUDIO_CAPABILITY"
	help
	  This symbol is a config macro.

config BT_AUDIO_BROADCAST_SRC_SUBGROUP_COUNT
	int "BT_AUDIO_BROADCAST_SRC_SUBGROUP_COUNT"
	default 0
	help
	  This symbol is a config macro.

config BT_AUDIO_BROADCAST_SOURCE
	bool "BT_AUDIO_BROADCAST_SOURCE"
	help
	  This symbol is a config macro.

config BT_AUDIO_BROADCAST_SINK
	bool "BT_AUDIO_BROADCAST_SINK"
	help
	  This symbol is a config macro.

config BT_AUDIO_BROADCAST_SRC_STREAM_COUNT
	int "BT_AUDIO_BROADCAST_SRC_STREAM_COUNT"
	default 0
	help
	  This symbol is a config macro.

config UTF8
	bool "BT_AUDIO_BROADCAST_SRC_STREAM_COUNT"
	help
	  This symbol is a config macro.

config LE_CONN_COUNT
	int "LE_CONN_COUNT"
	default 0
	help
	  This symbol is a config macro.
	  No prefix in generated macro

config BT_AUDIO_BROADCAST_SNK_STREAM_COUNT
	int "BT_AUDIO_BROADCAST_SNK_STREAM_COUNT"
	default 0
	help
	  This symbol is a config macro.

config BT_PACS_SNK_CONTEXT
	hex "BT_PACS_SNK_CONTEXT"
	default 0x0007
	help
	  This symbol is a config macro.

config BT_PACS_SRC_CONTEXT
	hex "BT_PACS_SRC_CONTEXT"
	default 0x0007
	help
	  This symbol is a config macro.

config TMAP_PERIPHERAL_SINGLE
	bool "TMAP_PERIPHERAL_SINGLE"
	help
	  This symbol is a config macro.

endmenu
```

## include/bluetooth/audio/config/Kconfig.has
```kconfig
# Bluetooth Audio - Hearing Access Service options
#
# Copyright (c) 2022 Codecoup
# Copyright 2024 NXP
#
# SPDX-License-Identifier: Apache-2.0

menu "has"

config BT_HAS
	bool "Hearing Access Service support"
	select UTF8
	select BT_GATT_DYNAMIC_DB
	depends on BT_BAP_UNICAST_SERVER
	help
	  This option enables support for Hearing Access Service.
	  This symbol is a config macro.

if BT_HAS

config BT_HAS_FEATURES_NOTIFIABLE
	bool "Hearing Aid Features Notifiable Support"
	help
	  This option enables support for clients to subscribe for notifications
	  on the Hearing Aid Features characteristic.
	  This symbol is a config macro.

config BT_HAS_PRESET_COUNT
	int "Preset record list size"
	default 2
	range 0 255
	help
	  This option sets the number of Hearing Access Service Presets
	  that can be registered. Setting this value to 0 disables Presets support.
	  This symbol is a config macro.

config BT_HAS_PRESET_SUPPORT
	def_bool BT_HAS_PRESET_COUNT > 0
	help
	  This symbol is a config macro.

if BT_HAS_PRESET_SUPPORT

config BT_HAS_PRESET_NAME_DYNAMIC
	bool "Allow to set preset name on runtime"
	help
	  Enabling this option allows for runtime configuration of preset name.
	  This symbol is a config macro.

config BT_HAS_PRESET_CONTROL_POINT_NOTIFIABLE
	bool "Preset Control Point Notifiable support"
	depends on BT_EATT
	help
	  This option enables support for clients to subscribe for notifications
	  on the Hearing Aid Preset Control Point characteristic.
	  This symbol is a config macro.

config BT_HAS_ACTIVE_PRESET_INDEX
	def_bool BT_HAS_PRESET_SUPPORT
	help
	  This option enables the Hearing Aid Active Preset Index characteristic.
	  This symbol is a config macro.

endif # BT_HAS_PRESET_SUPPORT

endif # BT_HAS

config BT_HAS_CLIENT
	bool "Hearing Access Service Client support"
	select BT_GATT_CLIENT
	select BT_GATT_AUTO_DISCOVER_CCC
	select BT_GATT_AUTO_UPDATE_MTU
	select UTF8
	help
	  This option enables support for Hearing Access Service Client.
	  This symbol is a config macro.

endmenu
```
