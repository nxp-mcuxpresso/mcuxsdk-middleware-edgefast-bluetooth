## include/bluetooth/audio/config/Kconfig.mcs
```kconfig
# Bluetooth Audio - Media control configuration options

#
# Copyright (c) 2020-2022 Nordic Semiconductor
# Copyright 2024 NXP
#
# SPDX-License-Identifier: Apache-2.0
#

menu "mcs"

#### Media Control Service ################################

config BT_MCS
	bool "Media Control Service Support"
	depends on MCTL_LOCAL_PLAYER_REMOTE_CONTROL
	depends on UTF8
	select BT_CCID
	select BT_GATT_DYNAMIC_DB
	help
	  This option enables support for the Media Control Service.
	  This symbol is a config macro.

#### Media Control Client ################################

config BT_MCC
	bool "Media Control Client Support"
	select BT_GATT_CLIENT
	select BT_GATT_AUTO_DISCOVER_CCC
	help
	  This option enables support for the Media Control Client.
	  This symbol is a config macro.

if BT_MCC

config BT_MCC_MEDIA_PLAYER_NAME_MAX
	int "Max length of media player name"
	default 20
	range 1 255
	help
	  Sets the maximum number of bytes (including the null termination) of
	  the name of the media player. If the name is longer, the media
	  control client will truncate the name when reading it.
	  This symbol is a config macro.

config BT_MCC_ICON_URL_MAX
	int "Max length of media player icon URL"
	default 40
	range 1 255
	help
	  Sets the maximum number of bytes (including the null termination) of
	  the media player icon URL. If the URL is longer, the media control
	  client will truncate the name when reading it.
	  This symbol is a config macro.

config BT_MCC_TRACK_TITLE_MAX
	int "Max length of the title of a track"
	default 40
	range 1 255
	help
	  Sets the maximum number of bytes (including the null termination) of
	  the title of any track in the media player. If the title is longer,
	  the media control client will truncate the title when reading it.
	  This symbol is a config macro.

config BT_MCC_SEGMENT_NAME_MAX
	int "Max length of the name of a track segment"
	default 25
	range 1 255
	help
	  Sets the the maximum number of bytes (including the null termination)
	  of the name of any track segment in the media player. If the name is
	  longer, the media control client will truncate the name when reading
	  it.
	  This symbol is a config macro.

config BT_MCC_OTS
	bool "Media Control Client support for Object Transfer Service"
	depends on BT_OTS_CLIENT
	help
	  Use this option to configure support in the Media Control Client for
	  an included Object Transfer Service in the Media Control Service.
	  This symbol is a config macro.

if BT_MCC_OTS

config BT_MCC_OTC_OBJ_BUF_SIZE
	int "The size of the buffer used for OTC object in MCC"
	default 512
	range 1 65536
	help
	  Sets the size (in octets) of the buffer used for receiving the content
	  of objects.
	  Should be set large enough to fit any expected object.
	  This symbol is a config macro.

config BT_MCC_TOTAL_OBJ_CONTENT_MEM
	int "Total memory size to use for storing the content of objects"
	default 1
	range 0 65536
	help
	  Sets the total memory size (in octets) to use for storing the content
	  of objects.
	  This is used for the total memory pool buffer size from which memory
	  is allocated when reading object content.
	  This symbol is a config macro.

config BT_MCC_TRACK_SEGS_MAX_CNT
	int "Maximum number of tracks segments in a track segment object"
	default 25
	range 0 500
	help
	  Sets the maximum number of tracks segments in a track segment object.
	  If the received object is bigger, the remaining data in the object
	  will be ignored.
	  This symbol is a config macro.

config BT_MCC_GROUP_RECORDS_MAX
	int "Maximum number of records in a group object"
	default 25
	range 0 500
	help
	  Sets the maximum number of records in a group object. If the received
	  group object has more records than this, the remaining records in the
	  object will be ignored.
	  This symbol is a config macro.

endif # BT_MCC_OTS

config BT_MCC_SHELL
	bool "Media Control Client Shell Support"
	default y if BT_SHELL
	help
	  This option enables shell support for the Media Control Client.
	  This symbol is a config macro.

config BT_MCC_MINIMAL
	bool "Minimal Media Control Client without optional procedures"
	help
	  This option disables all optional procedures in the Media Control Client.
	  This symbol is a config macro.

config BT_MCC_READ_MEDIA_PLAYER_ICON_URL
	bool "Support reading Media Player Icon URL"
	default !BT_MCC_MINIMAL
	help
	  This option enables support for Read Media Information procedure
	  optionally read the Media Player Icon URL.
	  This symbol is a config macro.

config BT_MCC_READ_TRACK_TITLE
	bool "Support reading Track Title"
	default !BT_MCC_MINIMAL
	help
	  This option enables support for reading Track Title.
	  This symbol is a config macro.

config BT_MCC_READ_TRACK_TITLE_ENABLE_SUBSCRIPTION
	bool "Support to enable or disable the subscription of Track Title"
	default !BT_MCC_MINIMAL
	help
	  This option enables support for the subscription of Track Title.
	  This symbol is a config macro.

config BT_MCC_READ_TRACK_DURATION
	bool "Support reading Track Duration"
	default !BT_MCC_MINIMAL
	help
	  This option enables support for reading Track Duration.
	  This symbol is a config macro.

config BT_MCC_READ_TRACK_POSITION
	bool "Support reading Track Position"
	default !BT_MCC_MINIMAL
	help
	  This option enables support for reading Track Position.
	  This symbol is a config macro.

config BT_MCC_SET_TRACK_POSITION
	bool "Support setting Track Position"
	default !BT_MCC_MINIMAL
	help
	  This option enables support for setting Track Position.
	  This symbol is a config macro.

config BT_MCC_READ_PLAYBACK_SPEED
	bool "Support reading Playback Speed"
	default !BT_MCC_MINIMAL
	help
	  This option enables support for reading Playback Speed.
	  This symbol is a config macro.

config BT_MCC_SET_PLAYBACK_SPEED
	bool "Support setting Playback Speed"
	default !BT_MCC_MINIMAL
	help
	  This option enables support for setting Playback Speed.
	  This symbol is a config macro.

config BT_MCC_READ_SEEKING_SPEED
	bool "Support reading Seeking Speed"
	default !BT_MCC_MINIMAL
	help
	  This option enables support for reading Seeking Speed.
	  This symbol is a config macro.

config BT_MCC_READ_PLAYING_ORDER
	bool "Support reading Playing Order"
	default !BT_MCC_MINIMAL
	help
	  This option enables support for reading Playing Order.
	  This symbol is a config macro.

config BT_MCC_SET_PLAYING_ORDER
	bool "Support setting Playing Order"
	default !BT_MCC_MINIMAL
	help
	  This option enables support for setting Playing Order.
	  This symbol is a config macro.

config BT_MCC_READ_PLAYING_ORDER_SUPPORTED
	bool "Support reading Playing Order Supported"
	default !BT_MCC_MINIMAL
	help
	  This option enables support for reading Playing Order Supported.
	  This symbol is a config macro.

config BT_MCC_READ_MEDIA_STATE
	bool "Support reading Media State"
	default !BT_MCC_MINIMAL
	help
	  This option enables support for reading Media State.
	  This symbol is a config macro.

config BT_MCC_SET_MEDIA_CONTROL_POINT
	bool "Support setting Media Control Point"
	default !BT_MCC_MINIMAL
	help
	  This option enables support for setting Media Control Point.
	  This symbol is a config macro.

config BT_MCC_READ_MEDIA_CONTROL_POINT_OPCODES_SUPPORTED
	bool "Support reading Media Control Point Opcodes Supported"
	default !BT_MCC_MINIMAL
	help
	  This option enables support for reading Media Control Point Opcodes Supported.
	  This symbol is a config macro.

config BT_MCC_READ_CONTENT_CONTROL_ID
	bool "Support reading Content Control ID"
	default !BT_MCC_MINIMAL
	help
	  This option enables support for reading Content Control ID.
	  This symbol is a config macro.

endif # BT_MCC

endmenu
```

## include/bluetooth/audio/config/Kconfig.pbp
```kconfig
# Bluetooth Audio - Public Broadcast Profile (PBP) options
#
# Copyright 2023-2024 NXP
#
# SPDX-License-Identifier: Apache-2.0
#

menu "pbp"

config BT_PBP
	bool "Public Broadcast Profile"
	help
	  Enabling this will enable PBP.
	  This symbol is a config macro.

endmenu
```

## include/bluetooth/audio/config/Kconfig.tmap
```kconfig
# Bluetooth Audio - Telephony and Media Audio Profile (TMAP) options
#
# Copyright 2023-2024 NXP
#
# SPDX-License-Identifier: Apache-2.0
#

menu "tmap"

config BT_TMAP
	bool "Telephony and Media Audio Profile"
	depends on BT_CAP_ACCEPTOR || BT_CAP_INITIATOR
	help
	  Enabling this will enable TMAP.
	  This symbol is a config macro.

endmenu
```

## include/bluetooth/audio/config/Kconfig.vocs
```kconfig
# Bluetooth Audio - Volume Offset Control Service options
#
# Copyright (c) 2020 Bose Corporation
# Copyright 2024 NXP
#
# SPDX-License-Identifier: Apache-2.0
#

menu "vocs"

##################### Volume Offset Control Service #####################

config BT_VOCS_MAX_INSTANCE_COUNT
	int "Volume Offset Control Service max instance count"
	default 0
	range 0 15
	help
	  This option sets the maximum number of instances of Volume Offset
	  Control Services.
	  This symbol is a config macro.

config BT_VOCS
	bool # hidden
	default y if BT_VOCS_MAX_INSTANCE_COUNT > 0
	help
	  This hidden option enables support for Volume Control Service.
	  This symbol is a config macro.

if BT_VOCS

config BT_VOCS_MAX_OUTPUT_DESCRIPTION_SIZE
	int "Volume Offset Control Service max output description size"
	default 32
	range 0 512
	help
	  This option sets the maximum output description size in octets.
	  This symbol is a config macro.

endif # BT_VOCS

##################### Volume Offset Control Service Client #####################

config BT_VOCS_CLIENT_MAX_INSTANCE_COUNT
	int "Volume Offset Control Service client max instance count"
	default 0
	range 0 15
	help
	  This option sets the maximum number of instances of Volume Offset
	  Control Service clients.
	  This symbol is a config macro.

config BT_VOCS_CLIENT
	bool # hidden
	default y if BT_VOCS_CLIENT_MAX_INSTANCE_COUNT > 0
	help
	  This hidden option enables support for Volume Offset Control Service.
	  This symbol is a config macro.

endmenu
```
